/ {
    soc {
        dac1: dac@40007400 {
            compatible = "st,stm32-dac";
            reg = <0x40007400 0x400>;
            clocks = <&rcc STM32_CLOCK_BUS_APB1 0x20000000>;
            status = "okay";
            pinctrl-names = "default";
            pinctrl-0 = <&dac_out1_pa4>;
        };
    };
};

